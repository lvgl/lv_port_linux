## lv_conf.defconfig
```kconfig
CONFIG_LV_COLOR_DEPTH_16=y
CONFIG_LV_USE_CLIB_SPRINTF=y
CONFIG_LV_USE_CLIB_MALLOC=y
CONFIG_LV_USE_CLIB_STRING=y
CONFIG_LV_USE_VECTOR_GRAPHICS=y
CONFIG_LV_USE_WAYLAND=y
CONFIG_LV_USE_LINUX_FBDEV=y

CONFIG_LV_BUILD_DEMOS=y
CONFIG_LV_USE_DEMO_WIDGETS=y
```
